/*@!Encoding:936*/
/* One isolated 0x211 bench intrusion per Web request. */

variables
{
  message 0x211 TorqueFrame;
  msTimer TamperTimer;
  msTimer FinishTimer;
  byte Baseline[8];
  byte TamperByte = 0;
  byte TamperMask = 1;
  int AttackActive = 0;
  long LastAttackSequence = 0;
}

on start
{
  Baseline[0] = 0x2A;
  Baseline[1] = 0x30;
  Baseline[2] = 0x54;
  Baseline[3] = 0x61;
  Baseline[4] = 0x88;
  Baseline[5] = 0x00;
  Baseline[6] = 0x01;
  Baseline[7] = 0x6D;
  @sysvar::VShield::AttackState = 0;
  write("BodyAttack 0x211 one-shot bench mode ready");
}

on sysvar_update sysvar::VShield::AttackRequest
{
  long sequence;
  int index;
  sequence = @sysvar::VShield::AttackRequest;
  if (sequence == 0 || sequence == LastAttackSequence || AttackActive)
  {
    return;
  }
  LastAttackSequence = sequence;
  AttackActive = 1;
  /* Select only bits with unambiguous meanings in the supplied matrix. */
  TamperByte = (byte)(1 + random(3));
  if (TamperByte == 1)
  {
    TamperMask = 0x02; /* bit 9: real wheel torque */
  }
  else if (TamperByte == 2)
  {
    TamperMask = (byte)(1 << random(8)); /* bits 16..23: real wheel torque */
  }
  else
  {
    TamperMask = (byte)(1 << random(2)); /* bits 24/25: two status flags */
  }
  TorqueFrame.dlc = 8;
  for (index = 0; index < 8; index++)
  {
    TorqueFrame.byte(index) = Baseline[index];
  }
  @sysvar::VShield::AttackState = 1;
  output(TorqueFrame);
  write("0x211 baseline sent; sequence=%d, byte=%d, mask=0x%02X",
        sequence, TamperByte, TamperMask);
  setTimer(TamperTimer, 20);
}

on timer TamperTimer
{
  TorqueFrame.byte(TamperByte) = Baseline[TamperByte] ^ TamperMask;
  output(TorqueFrame);
  write("0x211 tampered frame sent once; byte=%d", TamperByte);
  setTimer(FinishTimer, 1000);
}

on timer FinishTimer
{
  AttackActive = 0;
  @sysvar::VShield::AttackState = 2;
  write("0x211 one-shot attack complete");
}
